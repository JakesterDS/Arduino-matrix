const int dataPin = 9;
const int clockPin = 10;
const int latchPin = 11;

int counter;

const int screen_orientation=0; //skriv 1 i stedet for 0, hvis mitrix'et virker omvendt!

int All_on[8][30] = {
  {1, 1, 1, 1, 1, 1, 1, 1, 1, 1, 1, 1, 1, 1, 1, 1, 1, 1, 1, 1, 1, 1, 1, 1, 1, 1, 1, 1, 1, 1},
  {1, 1, 1, 1, 1, 1, 1, 1, 1, 1, 1, 1, 1, 1, 1, 1, 1, 1, 1, 1, 1, 1, 1, 1, 0, 1, 1, 1, 1, 1},
  {1, 1, 1, 1, 1, 1, 1, 1, 1, 1, 1, 1, 1, 1, 1, 1, 1, 1, 1, 1, 1, 1, 1, 1, 1, 1, 1, 1, 1, 1},
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  {1, 1, 1, 1, 1, 1, 1, 1, 1, 1, 1, 1, 1, 1, 1, 1, 1, 1, 1, 1, 1, 1, 1, 1, 1, 1, 1, 1, 1, 1},      
};

int All_off[8][30] = {
  {0, 0, 0, 0, 0, 0, 0, 0, 0, 0, 0, 0, 0, 0, 0, 0, 0, 0, 0, 0, 0, 0, 0, 0, 0, 0, 0, 0, 0, 0},
  {0, 0, 0, 0, 0, 0, 0, 0, 0, 0, 0, 0, 0, 0, 0, 0, 0, 0, 0, 0, 0, 0, 0, 0, 0, 0, 0, 0, 0, 0},
  {0, 0, 0, 0, 0, 0, 0, 0, 0, 0, 0, 0, 0, 0, 0, 0, 0, 0, 0, 0, 0, 0, 0, 0, 0, 0, 0, 0, 0, 0},
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  {0, 0, 0, 0, 0, 0, 0, 0, 0, 0, 0, 0, 0, 0, 0, 0, 0, 0, 0, 0, 0, 0, 0, 0, 0, 0, 0, 0, 0, 0},
};

int bold[8][30] = {
  {1, 1, 1, 1, 0, 0, 0, 0, 0, 0, 0, 0, 0, 0, 0, 0, 0, 0, 0, 0, 0, 0, 0, 0, 0, 0, 0, 0, 0, 0},
  {0, 0, 0, 0, 1, 1, 1, 0, 0, 0, 0, 0, 0, 0, 0, 0, 0, 0, 0, 0, 0, 0, 0, 0, 0, 0, 0, 1, 1, 1},
  {0, 0, 0, 0, 0, 0, 0, 1, 1, 1, 0, 0, 0, 0, 0, 0, 0, 0, 0, 0, 0, 0, 0, 0, 1, 1, 1, 0, 0, 0},
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  {0, 0, 0, 0, 0, 0, 0, 0, 0, 0, 0, 0, 0, 0, 0, 0, 1, 1, 0, 0, 0, 0, 0, 0, 0, 0, 0, 0, 0, 0},
};

int hej[8][30] = {
  {1, 1, 0, 0, 1, 1, 0, 0, 1, 1, 1, 1, 1, 0, 0, 0, 0, 0, 1, 1, 0, 0, 0, 0, 0, 0, 0, 0, 0, 0},
  {1, 1, 0, 0, 1, 1, 0, 0, 1, 1, 1, 1, 1, 0, 0, 0, 0, 0, 1, 1, 0, 0, 0, 0, 0, 0, 0, 0, 0, 0},
  {1, 1, 0, 0, 1, 1, 0, 0, 1, 1, 0, 0, 0, 0, 0, 0, 0, 0, 1, 1, 0, 0, 0, 0, 0, 0, 0, 0, 0, 0},
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  {1, 1, 0, 0, 1, 1, 0, 0, 1, 1, 1, 1, 1, 0, 0, 1, 1, 1, 1, 0, 0, 0, 0, 0, 0, 0, 0, 0, 0, 0},
};

int pil[8][30] = {
  {0, 0, 0, 1, 0, 0, 0, 0, 0, 0, 0, 0, 0, 0, 0, 0, 0, 0, 0, 0, 0, 0, 0, 0, 0, 0, 0, 0, 0, 0},
  {0, 0, 1, 1, 0, 0, 0, 0, 0, 0, 0, 0, 0, 0, 0, 0, 0, 0, 0, 0, 0, 0, 0, 0, 0, 0, 0, 0, 0, 0},
  {0, 1, 1, 1, 1, 1, 1, 1, 1, 0, 0, 0, 0, 0, 0, 0, 0, 0, 0, 0, 0, 0, 0, 0, 0, 0, 0, 0, 0, 0},
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  {0, 0, 0, 1, 0, 0, 0, 0, 0, 0, 0, 0, 0, 0, 0, 0, 0, 0, 0, 0, 0, 0, 0, 0, 0, 0, 0, 0, 0, 0},
};

int ram[8] = {0,0,0,0,0,0,0,0};

/*---------------- all commands ----------------
 lightLED
 randomLED
 ----- mitrix's -----
 All_on
 All_off
 kryds
 streg
 */


//---------------- setup ----------------
void setup() {
  pinMode(latchPin, OUTPUT);
  pinMode(clockPin, OUTPUT);
  pinMode(dataPin, OUTPUT);
}

//---------------- loop ----------------
void loop() {
  moveObj(pil);
  lightLED(pil);
  //randomLED();
  //lightLED(All_off);
  
  counter++;
}

//---------------- moveObj ----------------
void moveObj(int moveTempObj[8][30]){
  if (counter>10){      //ændre evt. hastigheden
    for (int y = 0; y < 8; y++) {  
      for (int x = 0; x < 30; x ++) {
        if (moveTempObj[y][x] == 1) {
          moveTempObj[y][x-1]=1;
          if (x-1==-1){
            ram[y]=1;
          }
        }
        else{
          moveTempObj[y][x-1]=0;
          if (x-1==-1){
            ram[y]=0;
          }
        }
      }
    }
    for (int y = 0; y < 8; y++){
      moveTempObj[y][29]=ram[y];
    }
    counter=0;
  }
}

//---------------- randomLED ----------------
void randomLED(){  
  if (random(3)==2){    //ændre evt. hastigheden
    int rx=random(0, 30);
    int ry=random(0, 8);

    if (All_off[ry][rx]==1){
      All_off[ry][rx]=0;
    }
    else{
      All_off[ry][rx]=1;
    }
  }
}

//---------------- lightLED ----------------
void lightLED(int tempLED[8][30]) {
  byte RowToSend = 0;
  byte ColOneSend = 0;
  byte ColTwoToSend = 0;
  byte ColThreeToSend = 0;
  byte ColFourToSend = 0;

  for (int y = 0; y < 8; y++) {
    RowToSend = 0;
    ColOneSend = 0;
    ColTwoToSend = 0;
    ColThreeToSend = 0;
    ColFourToSend = 0;
    
    for (int x = 0; x < 8; x ++) {
      if (tempLED[y][x] == screen_orientation) {
        bitWrite(ColOneSend, x, HIGH);
      } 
    }

    for (int x = 8; x < 16; x ++) {
      if (tempLED[y][x] == screen_orientation) {
        bitWrite(ColTwoToSend, x-8, HIGH);
      } 
    }
    
    for (int x = 16; x < 24; x ++) {
      if (tempLED[y][x] == screen_orientation) {
        bitWrite(ColThreeToSend, x-16, HIGH);
      } 
    }
    
    for (int x = 24; x < 30; x ++) {
      if (tempLED[y][x] == screen_orientation) {
        bitWrite(ColFourToSend, x-24, HIGH);
      } 
    }

    digitalWrite(latchPin, LOW);
    bitWrite(RowToSend, y, HIGH);
    shiftOut(dataPin, clockPin, MSBFIRST, ColFourToSend);
    shiftOut(dataPin, clockPin, MSBFIRST, ColThreeToSend);
    shiftOut(dataPin, clockPin, MSBFIRST, ColTwoToSend);
    shiftOut(dataPin, clockPin, MSBFIRST, ColOneSend);
    shiftOut(dataPin, clockPin, MSBFIRST, RowToSend);
    digitalWrite(latchPin, HIGH);   
    // delay(1);
  }
}





